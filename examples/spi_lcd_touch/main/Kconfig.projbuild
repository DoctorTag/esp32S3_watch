## examples/spi_lcd_touch/main/Kconfig.projbuild
```kconfig
menu "Example Configuration"

    choice EXAMPLE_LCD_CONTROLLER
        prompt "LCD controller model"
        default EXAMPLE_LCD_CONTROLLER_ST7789
        help
            Select LCD controller model

        config EXAMPLE_LCD_CONTROLLER_ST7789
            bool "ST7789"

        config EXAMPLE_LCD_CONTROLLER_GC9B71
            bool "GC9B71"
    endchoice

    config EXAMPLE_LCD_TOUCH_ENABLED
        bool "Enable LCD touch"
        default n
        help
            Enable this option if you wish to use display touch. You can select from touch controllers.

    choice EXAMPLE_LCD_TOUCH_CONTROLLER
        prompt "LCD touch controller model"
        depends on EXAMPLE_LCD_TOUCH_ENABLED
        default EXAMPLE_LCD_TOUCH_CONTROLLER_CST816
        help
            Select LCD touch controller model

        config EXAMPLE_LCD_TOUCH_CONTROLLER_CST816
            bool "CST816"
            help
                Touch controller CST816 connected via I2C.
    endchoice

endmenu
```
